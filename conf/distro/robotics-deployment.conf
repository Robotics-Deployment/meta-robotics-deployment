## conf/distro/robotics-deployment.conf
```bitbake
# robotics-deployment.conf

DISTRO = "robotics-deployment"
DISTRO_NAME = "Robotics Deployment Distro"
DISTRO_VERSION = "0.1"
LICENSE_FLAGS_ACCEPTED = "synaptics-killswitch"
INIT_MANAGER = "systemd"
DISTRO_FEATURES:append = " systemd virtualization"
VIRTUAL-RUNTIME_init_manager = "systemd"
```

## conf/layer.conf
```bitbake
# We have a conf and classes directory, add to BBPATH
BBPATH .= ":${LAYERDIR}"

# We have recipes-* directories, add to BBFILES
BBFILES += "${LAYERDIR}/recipes-*/*/*.bb \
            ${LAYERDIR}/recipes-*/*/*.bbappend"

BBFILE_COLLECTIONS += "meta-robotics-deployment"
BBFILE_PATTERN_meta-robotics-deployment = "^${LAYERDIR}/"
BBFILE_PRIORITY_meta-robotics-deployment = "25"

LAYERDEPENDS_meta-robotics-deployment = "core"
LAYERSERIES_COMPAT_meta-robotics-deployment = "mickledore"
```
